## drivers/clk/tegra/Kconfig
```kconfig
# SPDX-License-Identifier: GPL-2.0-only
config TEGRA_CLK_EMC
	def_bool y
	depends on TEGRA124_EMC

config CLK_TEGRA_BPMP
	def_bool y
	depends on TEGRA_BPMP
```

## drivers/nvme/Kconfig
```kconfig
# SPDX-License-Identifier: GPL-2.0-only

source "drivers/nvme/host/Kconfig"
source "drivers/nvme/target/Kconfig"
```

## drivers/video/fbdev/omap2/Kconfig
```kconfig
# SPDX-License-Identifier: GPL-2.0-only
if ARCH_OMAP2PLUS

source "drivers/video/fbdev/omap2/omapfb/Kconfig"

endif
```
